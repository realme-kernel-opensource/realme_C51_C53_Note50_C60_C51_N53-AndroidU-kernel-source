## drivers/input/lcd_bias/Kconfig
```kconfig
config LCM_BIAS_VOLTAGE_ON
	tristate "bias voltage of lcm"
	default m
	depends on I2C
	help
	  Turn on this config.the bias of lcm will setting when turn on screen.
	  If unsure, say N.
```

## drivers/input/touchscreen/chipone_icnl__9916c/Kconfig
```kconfig
config TOUCHSCREEN_CHIPONE
	tristate "Chipone TDDI touchscreen"
	default m
	help
	  Say y here if you have chipone TDDI touch panel.
	  If unsure, say N.
```

## drivers/input/touchscreen/focaltech_spi/Kconfig
```kconfig
#
# Focaltech Touchscreen driver configuration
#

config TOUCHSCREEN_FOCALTECH_SPI
    tristate "Focaltech Touchscreen"
    default m
    help
      Say Y here if you have Focaltech touch panel.
      If unsure, say N.
```

## drivers/misc/device_info/Kconfig
```kconfig
config OPLUS_DEVICE_IFNO
	tristate	"OPLUS_DEVICE_IFNO"
	help
		define this config to compile device_info.c for device register
```

## drivers/misc/hqhardwareinfo/Kconfig
```kconfig
config HQ_HARDWARE_INFO
	tristate CONFIG_HQ_HARDWARE_INFO
	help
		CONFIG_HQ_HARDWARE_INFO
```

## drivers/nfc/pn557/Kconfig
```kconfig
# SPDX-License-Identifier: GPL-2.0-only
#
# Nxp Nci protocol (I2C) devices
#

config NFC_PN557
        tristate "Nxp pn557 NCI protocol driver (I2C) devices"
        default m
        help
          You'll have to say Y if your computer contains an I2C device that
          you want to use under Linux.

          You can say N here if you don't have any SPI connected to your computer.
```

## drivers/soc/Kconfig
```kconfig
# SPDX-License-Identifier: GPL-2.0-only
menu "SOC (System On Chip) specific Drivers"

source "drivers/soc/actions/Kconfig"
source "drivers/soc/amlogic/Kconfig"
source "drivers/soc/aspeed/Kconfig"
source "drivers/soc/atmel/Kconfig"
source "drivers/soc/bcm/Kconfig"
source "drivers/soc/fsl/Kconfig"
source "drivers/soc/imx/Kconfig"
source "drivers/soc/ixp4xx/Kconfig"
source "drivers/soc/mediatek/Kconfig"
source "drivers/soc/qcom/Kconfig"
source "drivers/soc/renesas/Kconfig"
source "drivers/soc/rockchip/Kconfig"
source "drivers/soc/samsung/Kconfig"
source "drivers/soc/sprd/Kconfig"
source "drivers/soc/sunxi/Kconfig"
source "drivers/soc/tegra/Kconfig"
source "drivers/soc/ti/Kconfig"
source "drivers/soc/ux500/Kconfig"
source "drivers/soc/versatile/Kconfig"
source "drivers/soc/xilinx/Kconfig"
source "drivers/soc/zte/Kconfig"
#Bin.Li@EXP.BSP.bootloader.bootflow, 2021/07/05, Add for oppo device info and oppo project
#source "drivers/soc/oppo/Kconfig"
source "drivers/soc/oplus/system/oplus_phoenix/Kconfig"
source "drivers/soc/oplus/system/hung_task_enhance/Kconfig"
endmenu
```

## drivers/soc/oplus/system/hung_task_enhance/Kconfig
```kconfig
# SPDX-License-Identifier: GPL-2.0-only
# Copyright (C) 2018-2020 Oplus. All rights reserved.
config OPLUS_FEATURE_HUNG_TASK_ENHANCE
	tristate "system hung task enhance"
	default n
	help
      define this config to enable QCOM platform uboot log .

config OPLUS_FEATURE_DEATH_HEALER
	tristate "Enable DeathHealer"
	default n
	help
	  define this config to enable DEATH_HEALER .
```

## drivers/soc/sprd/debug/sysdump/Kconfig
```kconfig
config SPRD_SYSDUMP
	bool "Enable SPRD sysdump handler"
	depends on ARCH_SPRD && !KEXEC_CORE
	help
	  This option enables Spreatrum sysdump which prepare debug info
	  for u-boot to write into mmc storage after kernel panics.

config SPRD_MINI_SYSDUMP
	depends on SPRD_SYSDUMP
	bool "Enable SPRD mini sysdump handler"
	help
	  This option enables Spreatrum mini sysdump which supplies simple
	  debug info for projects can not support external sd card after
	  system occurs kernel panics.

config SPRD_EMERGENCY_RESTART
	bool "SPRD emergency restart function defination"
	help
		This option enables Spreatrum emergency restart which transfer
		argument as reboot reason for watchdog reboot handler

config SPRD_NATIVE_HANG_MONITOR
	bool "Enable SPRD android native hang detect handler"
	help
		This option enables Spreatrum android native hang detect which prepare debug info
		for the case to debug.

config SPRD_CLOSE_CRASH_KEY
	bool "Disable crash_key trigger kernel panic"
	depends on SPRD_SYSDUMP
	default n
	help
		This option disables Spreatrum crash_key which tigger kernel panic
		to debug.
```
